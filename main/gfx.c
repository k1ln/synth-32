/*
 * gfx.c — RGB565 framebuffer renderer + LCD init
 * Physical buffer: portrait 720×1280 (HX8394 native).
 * Logical coordinate space: 1280×720 landscape.
 *
 * Coordinate transform (rotation=1, mirror_x=1):
 *   physical (px, py) = (ly, 1279 - lx)
 * Each logical column maps to one contiguous PSRAM run → fast sequential writes.
 */

#include "gfx.h"
#include <string.h>
#include <math.h>
#include "freertos/FreeRTOS.h"
#include "freertos/task.h"
#include "freertos/semphr.h"
#include "esp_log.h"
#include "esp_cache.h"
#include "driver/gpio.h"
#include "bsp/esp-bsp.h"
#include "bsp/display.h"

static const char *TAG = "gfx";

/* ── Globals used by ui.c ────────────────────────────────────────────────── */
uint16_t              *g_fb        = NULL;   /* back buffer — always draw here */
esp_lcd_panel_handle_t g_dpi_panel = NULL;

static void          *s_fb[2]      = {};     /* [0] and [1] framebuffer pointers */
static int            s_back_idx   = 0;      /* index of current back buffer */
static SemaphoreHandle_t s_vsync_sem = NULL;
static volatile bool  s_present_pending = false; /* a frame is awaiting its latch */

#define BL_GPIO_FALLBACK GPIO_NUM_26

/* ── 8×8 bitmap font, ASCII 0x20–0x7F ───────────────────────────────────── */
static const uint8_t FONT8[96][8] = {
    /* 20 ' ' */ {0x00,0x00,0x00,0x00,0x00,0x00,0x00,0x00},
    /* 21 '!' */ {0x18,0x18,0x18,0x18,0x18,0x00,0x18,0x00},
    /* 22 '"' */ {0x66,0x66,0x44,0x00,0x00,0x00,0x00,0x00},
    /* 23 '#' */ {0x36,0x36,0x7F,0x36,0x7F,0x36,0x36,0x00},
    /* 24 '$' */ {0x0C,0x3E,0x03,0x1E,0x30,0x1F,0x06,0x00},
    /* 25 '%' */ {0x62,0x66,0x0C,0x18,0x30,0x66,0x46,0x00},
    /* 26 '&' */ {0x1C,0x36,0x1C,0x5B,0x73,0x66,0x5C,0x00},
    /* 27 '\''*/ {0x06,0x06,0x03,0x00,0x00,0x00,0x00,0x00},
    /* 28 '(' */ {0x18,0x0C,0x06,0x06,0x06,0x0C,0x18,0x00},
    /* 29 ')' */ {0x06,0x0C,0x18,0x18,0x18,0x0C,0x06,0x00},
    /* 2A '*' */ {0x00,0x36,0x1C,0x7F,0x1C,0x36,0x00,0x00},
    /* 2B '+' */ {0x00,0x18,0x18,0x7E,0x18,0x18,0x00,0x00},
    /* 2C ',' */ {0x00,0x00,0x00,0x00,0x00,0x1C,0x0C,0x06},
    /* 2D '-' */ {0x00,0x00,0x00,0x7E,0x00,0x00,0x00,0x00},
    /* 2E '.' */ {0x00,0x00,0x00,0x00,0x00,0x18,0x18,0x00},
    /* 2F '/' */ {0x60,0x30,0x18,0x0C,0x06,0x03,0x01,0x00},
    /* 30 '0' */ {0x3C,0x66,0x6E,0x76,0x66,0x66,0x3C,0x00},
    /* 31 '1' */ {0x0C,0x0E,0x0C,0x0C,0x0C,0x0C,0x3F,0x00},
    /* 32 '2' */ {0x3C,0x66,0x60,0x30,0x0C,0x06,0x7E,0x00},
    /* 33 '3' */ {0x3C,0x66,0x60,0x38,0x60,0x66,0x3C,0x00},
    /* 34 '4' */ {0x30,0x38,0x3C,0x36,0x7F,0x30,0x30,0x00},
    /* 35 '5' */ {0x7E,0x06,0x3E,0x60,0x60,0x66,0x3C,0x00},
    /* 36 '6' */ {0x38,0x06,0x3E,0x66,0x66,0x66,0x3C,0x00},
    /* 37 '7' */ {0x7E,0x60,0x30,0x18,0x0C,0x0C,0x0C,0x00},
    /* 38 '8' */ {0x3C,0x66,0x66,0x3C,0x66,0x66,0x3C,0x00},
    /* 39 '9' */ {0x3C,0x66,0x66,0x7C,0x60,0x30,0x1E,0x00},
    /* 3A ':' */ {0x00,0x18,0x18,0x00,0x18,0x18,0x00,0x00},
    /* 3B ';' */ {0x00,0x18,0x18,0x00,0x18,0x0C,0x06,0x00},
    /* 3C '<' */ {0x60,0x30,0x18,0x0C,0x18,0x30,0x60,0x00},
    /* 3D '=' */ {0x00,0x00,0x7E,0x00,0x7E,0x00,0x00,0x00},
    /* 3E '>' */ {0x06,0x0C,0x18,0x30,0x18,0x0C,0x06,0x00},
    /* 3F '?' */ {0x3C,0x66,0x60,0x30,0x18,0x00,0x18,0x00},
    /* 40 '@' */ {0x3E,0x63,0x6B,0x7B,0x6B,0x03,0x3E,0x00},
    /* 41 'A' */ {0x18,0x3C,0x66,0x66,0x7E,0x66,0x66,0x00},
    /* 42 'B' */ {0x3E,0x66,0x66,0x3E,0x66,0x66,0x3E,0x00},
    /* 43 'C' */ {0x3C,0x66,0x06,0x06,0x06,0x66,0x3C,0x00},
    /* 44 'D' */ {0x1E,0x36,0x66,0x66,0x66,0x36,0x1E,0x00},
    /* 45 'E' */ {0x7E,0x06,0x06,0x3E,0x06,0x06,0x7E,0x00},
    /* 46 'F' */ {0x7E,0x06,0x06,0x3E,0x06,0x06,0x06,0x00},
    /* 47 'G' */ {0x3C,0x66,0x06,0x76,0x66,0x66,0x3C,0x00},
    /* 48 'H' */ {0x66,0x66,0x66,0x7E,0x66,0x66,0x66,0x00},
    /* 49 'I' */ {0x3E,0x0C,0x0C,0x0C,0x0C,0x0C,0x3E,0x00},
    /* 4A 'J' */ {0x78,0x30,0x30,0x30,0x30,0x36,0x1C,0x00},
    /* 4B 'K' */ {0x66,0x36,0x1E,0x0E,0x1E,0x36,0x66,0x00},
    /* 4C 'L' */ {0x06,0x06,0x06,0x06,0x06,0x06,0x7E,0x00},
    /* 4D 'M' */ {0x63,0x77,0x7F,0x6B,0x63,0x63,0x63,0x00},
    /* 4E 'N' */ {0x66,0x6E,0x7E,0x76,0x66,0x66,0x66,0x00},
    /* 4F 'O' */ {0x3C,0x66,0x66,0x66,0x66,0x66,0x3C,0x00},
    /* 50 'P' */ {0x3E,0x66,0x66,0x3E,0x06,0x06,0x06,0x00},
    /* 51 'Q' */ {0x3C,0x66,0x66,0x66,0x6E,0x3C,0x70,0x00},
    /* 52 'R' */ {0x3E,0x66,0x66,0x3E,0x1E,0x36,0x66,0x00},
    /* 53 'S' */ {0x3C,0x66,0x06,0x1C,0x30,0x66,0x3C,0x00},
    /* 54 'T' */ {0x7E,0x18,0x18,0x18,0x18,0x18,0x18,0x00},
    /* 55 'U' */ {0x66,0x66,0x66,0x66,0x66,0x66,0x3C,0x00},
    /* 56 'V' */ {0x66,0x66,0x66,0x66,0x66,0x3C,0x18,0x00},
    /* 57 'W' */ {0x63,0x63,0x63,0x6B,0x7F,0x77,0x63,0x00},
    /* 58 'X' */ {0x66,0x66,0x3C,0x18,0x3C,0x66,0x66,0x00},
    /* 59 'Y' */ {0x66,0x66,0x66,0x3C,0x18,0x18,0x18,0x00},
    /* 5A 'Z' */ {0x7E,0x60,0x30,0x18,0x0C,0x06,0x7E,0x00},
    /* 5B '[' */ {0x1E,0x06,0x06,0x06,0x06,0x06,0x1E,0x00},
    /* 5C '\\'*/ {0x03,0x06,0x0C,0x18,0x30,0x60,0x40,0x00},
    /* 5D ']' */ {0x1E,0x18,0x18,0x18,0x18,0x18,0x1E,0x00},
    /* 5E '^' */ {0x18,0x3C,0x66,0x00,0x00,0x00,0x00,0x00},
    /* 5F '_' */ {0x00,0x00,0x00,0x00,0x00,0x00,0x00,0xFF},
    /* 60 '`' */ {0x0C,0x18,0x30,0x00,0x00,0x00,0x00,0x00},
    /* 61 'a' */ {0x00,0x00,0x3C,0x60,0x7C,0x66,0x7C,0x00},
    /* 62 'b' */ {0x06,0x06,0x3E,0x66,0x66,0x66,0x3E,0x00},
    /* 63 'c' */ {0x00,0x00,0x3C,0x06,0x06,0x06,0x3C,0x00},
    /* 64 'd' */ {0x60,0x60,0x7C,0x66,0x66,0x66,0x7C,0x00},
    /* 65 'e' */ {0x00,0x00,0x3C,0x66,0x7E,0x06,0x3C,0x00},
    /* 66 'f' */ {0x38,0x0C,0x0C,0x3E,0x0C,0x0C,0x0C,0x00},
    /* 67 'g' */ {0x00,0x00,0x7C,0x66,0x66,0x7C,0x60,0x3C},
    /* 68 'h' */ {0x06,0x06,0x3E,0x66,0x66,0x66,0x66,0x00},
    /* 69 'i' */ {0x18,0x00,0x1E,0x18,0x18,0x18,0x7E,0x00},
    /* 6A 'j' */ {0x30,0x00,0x30,0x30,0x30,0x30,0x36,0x1C},
    /* 6B 'k' */ {0x06,0x06,0x36,0x1E,0x0E,0x1E,0x36,0x00},
    /* 6C 'l' */ {0x0E,0x0C,0x0C,0x0C,0x0C,0x0C,0x3E,0x00},
    /* 6D 'm' */ {0x00,0x00,0x37,0x7F,0x6B,0x63,0x63,0x00},
    /* 6E 'n' */ {0x00,0x00,0x3E,0x66,0x66,0x66,0x66,0x00},
    /* 6F 'o' */ {0x00,0x00,0x3C,0x66,0x66,0x66,0x3C,0x00},
    /* 70 'p' */ {0x00,0x00,0x3E,0x66,0x66,0x3E,0x06,0x06},
    /* 71 'q' */ {0x00,0x00,0x7C,0x66,0x66,0x7C,0x60,0x60},
    /* 72 'r' */ {0x00,0x00,0x3E,0x06,0x06,0x06,0x06,0x00},
    /* 73 's' */ {0x00,0x00,0x3C,0x06,0x1C,0x30,0x1E,0x00},
    /* 74 't' */ {0x08,0x0C,0x3E,0x0C,0x0C,0x0C,0x38,0x00},
    /* 75 'u' */ {0x00,0x00,0x66,0x66,0x66,0x66,0x7C,0x00},
    /* 76 'v' */ {0x00,0x00,0x66,0x66,0x66,0x3C,0x18,0x00},
    /* 77 'w' */ {0x00,0x00,0x63,0x63,0x6B,0x7F,0x36,0x00},
    /* 78 'x' */ {0x00,0x00,0x66,0x3C,0x18,0x3C,0x66,0x00},
    /* 79 'y' */ {0x00,0x00,0x66,0x66,0x66,0x7C,0x60,0x3C},
    /* 7A 'z' */ {0x00,0x00,0x7E,0x30,0x18,0x0C,0x7E,0x00},
    /* 7B '{' */ {0x38,0x0C,0x0C,0x06,0x0C,0x0C,0x38,0x00},
    /* 7C '|' */ {0x18,0x18,0x18,0x18,0x18,0x18,0x18,0x00},
    /* 7D '}' */ {0x0E,0x18,0x18,0x30,0x18,0x18,0x0E,0x00},
    /* 7E '~' */ {0x76,0xDC,0x00,0x00,0x00,0x00,0x00,0x00},
    /* 7F DEL */ {0xFF,0x81,0x81,0x81,0x81,0x81,0xFF,0x00},
};

/* ── Primitives ──────────────────────────────────────────────────────────── */

void gfx_fill_rect(int lx, int ly, int w, int h, uint16_t col)
{
    if (w <= 0 || h <= 0 || !g_fb) return;
    if (lx < 0)         { w += lx; lx = 0; }
    if (ly < 0)         { h += ly; ly = 0; }
    if (lx + w > SCR_W) w = SCR_W - lx;
    if (ly + h > SCR_H) h = SCR_H - ly;
    if (w <= 0 || h <= 0) return;
    for (int dc = 0; dc < w; dc++) {
        uint16_t *p = g_fb + (size_t)(LCD_PH - 1 - (lx + dc)) * LCD_PW + ly;
        for (int k = 0; k < h; k++) p[k] = col;
    }
}

static inline void gfx_pixel(int lx, int ly, uint16_t col)
{
    if ((unsigned)lx >= (unsigned)SCR_W || (unsigned)ly >= (unsigned)SCR_H || !g_fb) return;
    g_fb[(size_t)(LCD_PH - 1 - lx) * LCD_PW + (unsigned)ly] = col;
}

void gfx_fill_screen(uint16_t col) { gfx_fill_rect(0, 0, SCR_W, SCR_H, col); }

void gfx_draw_rect(int x, int y, int w, int h, uint16_t col)
{
    gfx_fill_rect(x,         y,         w, 1, col);
    gfx_fill_rect(x,         y + h - 1, w, 1, col);
    gfx_fill_rect(x,         y,         1, h, col);
    gfx_fill_rect(x + w - 1, y,         1, h, col);
}

void gfx_fill_circle(int cx, int cy, int r, uint16_t col)
{
    for (int dy = -r; dy <= r; dy++) {
        int dx = (int)sqrtf((float)(r*r - dy*dy));
        gfx_fill_rect(cx - dx, cy + dy, 2*dx + 1, 1, col);
    }
}

void gfx_fill_round_rect(int x, int y, int w, int h, int r, uint16_t col)
{
    if (r <= 0) { gfx_fill_rect(x, y, w, h, col); return; }
    gfx_fill_rect(x,     y + r,     w,       h - 2*r, col);
    gfx_fill_rect(x + r, y,         w - 2*r, r,       col);
    gfx_fill_rect(x + r, y + h - r, w - 2*r, r,       col);
    for (int dy = 0; dy <= r; dy++) {
        int dx = (int)sqrtf((float)(r*r - dy*dy));
        gfx_fill_rect(x + r - dx,     y + r - dy,         dx, 1, col);
        gfx_fill_rect(x + w - r,      y + r - dy,         dx, 1, col);
        gfx_fill_rect(x + r - dx,     y + h - r + dy - 1, dx, 1, col);
        gfx_fill_rect(x + w - r,      y + h - r + dy - 1, dx, 1, col);
    }
}

void gfx_draw_round_rect(int x, int y, int w, int h, int r, uint16_t col)
{
    gfx_fill_rect(x + r, y,         w - 2*r, 1, col);
    gfx_fill_rect(x + r, y + h - 1, w - 2*r, 1, col);
    gfx_fill_rect(x,         y + r, 1, h - 2*r, col);
    gfx_fill_rect(x + w - 1, y + r, 1, h - 2*r, col);
    int bx = 0, by = r, d = 1 - r;
    while (bx <= by) {
        gfx_pixel(x + w-1-r+bx, y + r-by,     col);
        gfx_pixel(x + w-1-r+by, y + r-bx,     col);
        gfx_pixel(x + r-bx,     y + r-by,     col);
        gfx_pixel(x + r-by,     y + r-bx,     col);
        gfx_pixel(x + r-bx,     y + h-1-r+by, col);
        gfx_pixel(x + r-by,     y + h-1-r+bx, col);
        gfx_pixel(x + w-1-r+bx, y + h-1-r+by, col);
        gfx_pixel(x + w-1-r+by, y + h-1-r+bx, col);
        if (d < 0) d += 2*bx + 3;
        else { d += 2*(bx - by) + 5; by--; }
        bx++;
    }
}

static void gfx_draw_char(int x, int y, char c, uint16_t fg, uint16_t bg, int scale)
{
    int idx = (uint8_t)c - 0x20;
    if (idx < 0 || idx >= 96) idx = 0;
    const uint8_t *g = FONT8[idx];
    for (int row = 0; row < 8; row++) {
        uint8_t bits = g[row];
        for (int col = 0; col < 8; col++) {
            uint16_t color = (bits & (1u << col)) ? fg : bg;
            gfx_fill_rect(x + col*scale, y + row*scale, scale, scale, color);
        }
    }
}

void gfx_draw_text(int x, int y, const char *str, uint16_t fg, uint16_t bg, int scale)
{
    for (; *str; str++, x += 8*scale)
        gfx_draw_char(x, y, *str, fg, bg, scale);
}

int gfx_text_width(const char *str, int scale)
{
    return (int)strlen(str) * 8 * scale;
}

/* ── LCD init / commit ───────────────────────────────────────────────────── */

static bool refresh_done_cb(esp_lcd_panel_handle_t panel,
                             esp_lcd_dpi_panel_event_data_t *edata, void *ctx)
{
    (void)panel; (void)edata;
    SemaphoreHandle_t sem = (SemaphoreHandle_t)ctx;
    BaseType_t need_yield = pdFALSE;
    xSemaphoreGiveFromISR(sem, &need_yield);
    return need_yield == pdTRUE;
}

static void backlight_gpio_fallback(void)
{
    gpio_config_t bk = { .pin_bit_mask = 1ULL << BL_GPIO_FALLBACK,
                         .mode = GPIO_MODE_OUTPUT };
    if (gpio_config(&bk) == ESP_OK) {
        gpio_set_level(BL_GPIO_FALLBACK, 1);
        ESP_LOGI(TAG, "backlight fallback GPIO%d HIGH", (int)BL_GPIO_FALLBACK);
    }
}

void lcd_init(void)
{
    esp_lcd_panel_io_handle_t io;
    ESP_ERROR_CHECK(bsp_display_new(NULL, &g_dpi_panel, &io));
    ESP_ERROR_CHECK(esp_lcd_panel_disp_on_off(g_dpi_panel, true));

    esp_err_t r = bsp_display_backlight_on();
    if (r != ESP_OK) ESP_LOGW(TAG, "backlight_on: %s", esp_err_to_name(r));

    r = ESP_FAIL;
    for (int i = 0; i < 3 && r != ESP_OK; i++) {
        r = bsp_display_brightness_set(100);
        if (r != ESP_OK) vTaskDelay(pdMS_TO_TICKS(20));
    }
    if (r != ESP_OK) ESP_LOGW(TAG, "brightness set: %s", esp_err_to_name(r));

    backlight_gpio_fallback();

    ESP_ERROR_CHECK(esp_lcd_dpi_panel_get_frame_buffer(g_dpi_panel, 2, &s_fb[0], &s_fb[1]));
    s_back_idx = 0;
    g_fb = (uint16_t *)s_fb[s_back_idx];
    ESP_LOGI(TAG, "fb[0]=%p fb[1]=%p (%d×%d RGB565, double-buffered)", s_fb[0], s_fb[1], LCD_PW, LCD_PH);
}

void lcd_register_refresh_cb(void)
{
    s_vsync_sem = xSemaphoreCreateBinary();
    esp_lcd_dpi_panel_event_callbacks_t cbs = { .on_refresh_done = refresh_done_cb };
    ESP_ERROR_CHECK(esp_lcd_dpi_panel_register_event_callbacks(g_dpi_panel, &cbs, s_vsync_sem));
}

/* Block until the panel has latched the most recently presented frame, so the
 * back buffer we are about to draw into is no longer being scanned out.
 *
 * This is the deferred second half of gfx_commit(): instead of blocking on
 * vsync *inside* gfx_commit(), the wait is moved to the start of the NEXT frame.
 * That frees the UI task to poll the touch panel and dispatch note events during
 * the ~one frame the panel needs to latch, instead of stalling there. With the
 * redraw capped to ~33 ms and the panel refreshing faster than that, the give
 * has almost always already arrived by the next frame, so during live playing
 * this returns immediately and touch keeps sampling at the loop rate. */
void gfx_wait_present(void)
{
    if (s_present_pending && s_vsync_sem) {
        xSemaphoreTake(s_vsync_sem, pdMS_TO_TICKS(34));
        s_present_pending = false;
    }
}

/* Index of the buffer drawing currently targets (== g_fb). The other buffer is
 * the one being scanned out. Lets callers track per-buffer state so incremental
 * updates (e.g. piano-key highlights) can be applied tear-free to the back
 * buffer and presented via swap, instead of writing into the scanned buffer. */
int gfx_back_index(void) { return s_back_idx; }

/* Non-blocking variant of gfx_wait_present(): returns true and clears the
 * pending flag if the previously presented frame has latched (so the back buffer
 * is free to draw into), false if it is still pending. Never blocks, so the
 * caller's touch poll keeps running while a present is in flight. */
bool gfx_present_ready(void)
{
    if (!s_present_pending) return true;
    if (s_vsync_sem && xSemaphoreTake(s_vsync_sem, 0) == pdTRUE) {
        s_present_pending = false;
        return true;
    }
    return false;
}

void gfx_commit(void)
{
    if (!g_fb) return;
    /* Drop any stale "refresh done" give so the deferred gfx_wait_present()
     * blocks on the refresh that latches THIS frame, not an earlier one. */
    if (s_vsync_sem) xSemaphoreTake(s_vsync_sem, 0);
    /* Pass the back buffer pointer to draw_bitmap. The driver detects that it
     * lives inside its own fb array and flips cur_fb_index to it without any
     * copy — the display starts scanning this buffer at the next vsync. */
    esp_lcd_panel_draw_bitmap(g_dpi_panel, 0, 0, LCD_PW, LCD_PH, g_fb);
    s_present_pending = true;
    /* Swap g_fb to the OLD front buffer so the next frame is drawn there. It may
     * still be scanning until the next vsync, so we must NOT draw into it until
     * gfx_wait_present() (called at the top of the next frame) confirms the
     * latch. */
    s_back_idx ^= 1;
    g_fb = (uint16_t *)s_fb[s_back_idx];
}
